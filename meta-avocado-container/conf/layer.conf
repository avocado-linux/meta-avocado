## meta-avocado-container/conf/layer.conf
```bitbake
# We have a conf and classes directory, add to BBPATH
BBPATH .= ":${LAYERDIR}"

# We have recipes-* directories, add to BBFILES
BBFILES += "${LAYERDIR}/recipes-*/*/*.bb \
            ${LAYERDIR}/recipes-*/*/*.bbappend"

BBFILE_COLLECTIONS += "meta-avocado-container"
BBFILE_PATTERN_meta-avocado-container = "^${LAYERDIR}/"
BBFILE_PRIORITY_meta-avocado-container = "5"

LAYERDEPENDS_meta-avocado-container = "core"
LAYERSERIES_COMPAT_meta-avocado-container = "scarthgap"
```

## meta-avocado-nvidia/conf/layer.conf
```bitbake
# We have a conf and classes directory, add to BBPATH
BBPATH .= ":${LAYERDIR}"

# We have recipes-* directories, add to BBFILES
BBFILES += "${LAYERDIR}/recipes-*/*/*.bb \
            ${LAYERDIR}/recipes-*/*/*.bbappend"

BBFILE_COLLECTIONS += "meta-avocado-nvidia"
BBFILE_PATTERN_meta-avocado-nvidia = "^${LAYERDIR}/"
BBFILE_PRIORITY_meta-avocado-nvidia = "5"

LAYERDEPENDS_meta-avocado-nvidia = "core"
LAYERSERIES_COMPAT_meta-avocado-nvidia = "scarthgap"
```

## meta-avocado-nxp/conf/machine/avocado-frdm-imx93.conf
```bitbake
#@TYPE: Machine
#@NAME: NXP FRDM i.MX 93 
#@DESCRIPTION: NXP FRDM i.MX 93 development board 

MACHINEOVERRIDES =. "imx93-11x11-lpddr4x-evk:"

require conf/machine/imx93-11x11-lpddr4x-evk.conf
```

## meta-avocado-qemu/conf/layer.conf
```bitbake
# We have a conf and classes directory, add to BBPATH
BBPATH .= ":${LAYERDIR}"

# We have recipes-* directories, add to BBFILES
BBFILES += "${LAYERDIR}/recipes-*/*/*.bb \
            ${LAYERDIR}/recipes-*/*/*.bbappend"

BBFILE_COLLECTIONS += "meta-avocado-qemu"
BBFILE_PATTERN_meta-avocado-qemu = "^${LAYERDIR}/"
BBFILE_PRIORITY_meta-avocado-qemu = "5"

LAYERDEPENDS_meta-avocado-qemu = "core"
LAYERSERIES_COMPAT_meta-avocado-qemu = "scarthgap"
```

## meta-avocado-qemu/recipes-kernel/linux/files/avocado-qemux86-64/defconfig
```kconfig
CONFIG_LOCALVERSION="-yocto-minimal"
CONFIG_SYSVIPC=y
CONFIG_POSIX_MQUEUE=y
CONFIG_NO_HZ=y
CONFIG_HIGH_RES_TIMERS=y
CONFIG_PREEMPT=y

# Minimal Boot Essentials
CONFIG_BLK_DEV_INITRD=y
CONFIG_SMP=y
CONFIG_X86_X2APIC=y
CONFIG_HYPERVISOR_GUEST=y
CONFIG_PARAVIRT=y
CONFIG_EFI=y
CONFIG_EFI_STUB=y
CONFIG_HZ_1000=y
CONFIG_RD_ZSTD=y

# Minimal Systemd Support
CONFIG_CGROUPS=y
CONFIG_CGROUP_FREEZER=y
CONFIG_CGROUP_DEVICE=y
CONFIG_CGROUP_SCHED=y
CONFIG_CGROUP_CPUACCT=y
CONFIG_CGROUP_PIDS=y
CONFIG_CGROUP_PERF=y
CONFIG_BLK_CGROUP=y
CONFIG_USER_NS=y
CONFIG_NAMESPACES=y
CONFIG_FHANDLE=y

# Required for systemd System-Extensions
CONFIG_OVERLAY_FS=y
CONFIG_BLK_DEV_LOOP=y
CONFIG_BINFMT_MISC=y
CONFIG_DEVTMPFS=y
CONFIG_DEVTMPFS_MOUNT=y
CONFIG_TMPFS=y

# Essential Storage Drivers
CONFIG_BLK_DEV_SD=y
CONFIG_SCSI=y
CONFIG_SCSI_VIRTIO=y
CONFIG_ATA=y
CONFIG_SATA_AHCI=y
CONFIG_MD=n
CONFIG_BLK_DEV_DM=n

# Virtualization (for QEMU)
CONFIG_VIRTIO_PCI=y
CONFIG_VIRTIO_BLK=y
CONFIG_VIRTIO_MMIO=y

# Essential Input/Output
CONFIG_INPUT=y
CONFIG_INPUT_EVDEV=y
CONFIG_SERIAL_8250=y
CONFIG_SERIAL_8250_CONSOLE=y
CONFIG_VIRTIO_CONSOLE=y

# Remove Unnecessary Sound & Multimedia
CONFIG_SOUND=n
CONFIG_SND=n
CONFIG_MEDIA_SUPPORT=n

# USB
CONFIG_USB=y
CONFIG_USB_HID=y
CONFIG_USB_XHCI_HCD=y
CONFIG_USB_EHCI_HCD=y
CONFIG_USB_STORAGE=y

# RTC (Keep minimal)
CONFIG_RTC_CLASS=y
CONFIG_RTC_HCTOSYS=y

# Security (Minimal)
CONFIG_SECURITY=y
CONFIG_SECURITY_LANDLOCK=n

# Remove Tracing & Debugging
CONFIG_FTRACE=n
CONFIG_FUNCTION_TRACER=n
CONFIG_MAGIC_SYSRQ=n
CONFIG_DEBUG_KERNEL=n
CONFIG_CRYPTO_TEST=n
CONFIG_SAMPLE_KPROBES=n
CONFIG_SAMPLE_HW_BREAKPOINT=n
CONFIG_SAMPLE_CONFIGFS=n
CONFIG_UNWINDER_FRAME_POINTER=n

# Clean up warnings
CONFIG_BT_HIDP=n
CONFIG_USB_HIDDEV=n
CONFIG_HID_WACOM=n
```

## meta-avocado-qemu/wic/avocado-qemux86-64.wks
```
part /boot/efi --source bootimg-efi --sourceparams="loader=systemd-boot,initrd=avocado-image-initramfs-${MACHINE}.cpio.zst" --fstype=vfat --label boot --active --align 1024 --size 64M --part-type C12A7328-F81F-11D2-BA4B-00A0C93EC93B
part / --source rootfs --fstype=squashfs --align 1024 --part-type 4f68bce3-e8cd-4db1-96e7-fbcaf984b709
part /var --source rawcopy --sourceparams="file=${DEPLOY_DIR_IMAGE}/avocado-image-var-${MACHINE}.btrfs" --fstype=btrfs --align 1024 --uuid 4d21b016-b534-45c2-a9fb-5c16e091fd2d
bootloader --ptable gpt --timeout=0 --configfile="${DEPLOY_DIR_IMAGE}/boot.conf"
```

## meta-avocado-qemu/wic/qemux86-64.wks
```
part /boot/efi --source bootimg-efi --sourceparams="loader=systemd-boot,initrd=avocado-image-initramfs-${MACHINE}.cpio.zst" --fstype=vfat --label boot --active --align 1024 --size 64M --part-type C12A7328-F81F-11D2-BA4B-00A0C93EC93B
part / --source rootfs --fstype=squashfs --align 1024 --part-type 4f68bce3-e8cd-4db1-96e7-fbcaf984b709
bootloader --ptable gpt --timeout=0 --configfile="${DEPLOY_DIR_IMAGE}/boot.conf"
```

## meta-avocado-raspberrypi/wic/avocado-raspberrypi.wks
```
bootloader    --ptable gpt-hybrid

part boot_a   --source bootimg-partition --ondisk mmcblk0 --fstype=vfat     --label BOOT     --align 4096 --size 100 --mbr

part rootfs_a --source rootfs            --ondisk mmcblk0 --fstype=squashfs --align 4096 --size 128M --part-type b921b045-1df0-41c3-af44-4c6f280d3fae
part rootfs_b --source rootfs            --ondisk mmcblk0 --fstype=squashfs --align 4096 --size 128M

part /var     --source rawcopy --sourceparams="file=${DEPLOY_DIR_IMAGE}/avocado-image-var-${MACHINE}.btrfs" --fstype=btrfs --uuid 4d21b016-b534-45c2-a9fb-5c16e091fd2d --ondisk mmcblk0 --label DATA --align 4096
```

## meta-avocado-rubikpi/conf/machine/include/qcom-base.inc
```bitbake
SOC_FAMILY:prepend = "qcom:"
require conf/machine/include/soc-family.inc

#Define and add SOC_ARCH to the list of architectures compatible with the given target.
SOC_ARCH = "${@ d.getVar('SOC_FAMILY').replace('-', '_').replace('qcom:', '')}"
PACKAGE_EXTRA_ARCHS:append = "${@['', ' ${SOC_ARCH}']['${SOC_ARCH}' != "${MACHINE_ARCH}"]}"

# Supported BSP selections are: base, custom
# We intend to use 'custom' BSP by default.
# Specific MACHINEs or DISTROs might change this as needed.
QCOM_SELECTED_BSP ??= "custom"
MACHINEOVERRIDES =. "qcom-${QCOM_SELECTED_BSP}-bsp:"

# Set prebuilt pkgs default arch
PBT_ARCH ?= "${SOC_ARCH}"

# Provider for Graphics Library.
# qcom-base-bsp uses 'mesa' as GL provider
GL_PROVIDER ?= "qcom-adreno"
GL_PROVIDER:qcom-base-bsp ?= "mesa"

PREFERRED_PROVIDER_virtual/egl      = "${GL_PROVIDER}"
PREFERRED_PROVIDER_virtual/libgles1 = "${GL_PROVIDER}"
PREFERRED_PROVIDER_virtual/libgles2 = "${GL_PROVIDER}"

PREFERRED_PROVIDER_virtual/egl-native      = "mesa-native"
PREFERRED_PROVIDER_virtual/libgl-native    = "mesa-native"
PREFERRED_PROVIDER_virtual/libgles1-native = "mesa-native"
PREFERRED_PROVIDER_virtual/libgles2-native = "mesa-native"

# Provider for libgbm
PREFERRED_PROVIDER_virtual/libqbm ?= "qbm"
PREFERRED_PROVIDER_virtual/libgbm = "${@'msm' if d.getVar('GL_PROVIDER') == 'qcom-adreno' else 'mesa'}"

# Provider for linux kernel
# qcom-base-bsp uses 'linux-qcom-base' as kernel
PREFERRED_PROVIDER_virtual/kernel ?= "linux-qcom-custom"
PREFERRED_PROVIDER_virtual/kernel:qcom-base-bsp ?= "linux-qcom-base"

KERNEL_IMAGETYPE ?= "Image"
KERNEL_ALT_IMAGETYPE ?= "vmlinux"

# Recipe provider for boot critical nhlos bins
PREFERRED_PROVIDER_virtual/bootbins ?= "firmware-qcom-bootbins"

# Recipe provider for disk partition configuration
PREFERRED_PROVIDER_virtual/partconf ?= "firmware-qcom-partconf"

PREFERRED_PROVIDER_android-tools-conf = "android-tools-conf-configfs"

# Use qcom specific version of modemmanger in custom-bsp
PREFERRED_VERSION_modemmanager:qcom-custom-bsp ?= "1.22.0.qcom"
PREFERRED_VERSION_libqmi:qcom-custom-bsp ?= "1.34.0.qcom"
PREFERRED_VERSION_libqrtr-glib:qcom-custom-bsp ?= "1.2.0.qcom"

#Use qcom specific version of wpa-supplicant in custom-bsp
PREFERRED_VERSION_wpa-supplicant = "2.11"
PREFERRED_VERSION_wpa-supplicant:qcom-custom-bsp = "2.10.qcom"

#Use qcom specific version of fastrpc in custom-bsp
PREFERRED_VERSION_fastrpc:qcom-custom-bsp ?= "15.0.qcom"
#Use upstream fastrpc in base-bsp
PREFERRED_VERSION_fastrpc:qcom-base-bsp ?= "0.0+"

#Use version of libvirt from meta-qcom-hwe
PREFERRED_VERSION_libvirt = "9.2.0"

#Use version of android-tools from meta-openembedded
PREFERRED_VERSION_android-tools ?= "5.1.1.r37"

# For module signing
INHERIT += " qmodule"

# QDL expects 4096 aligned ext4 image for flashing
IMAGE_FSTYPES = "ext4"
IMAGE_ROOTFS_ALIGNMENT = "4096"
EXTRA_IMAGECMD:ext4 = "-i 4096 -b 4096"

#Add options to ota-esp
EXTRA_IMAGECMD:ota-ext4:append = " -O encrypt,stable_inodes"

# Mask out tar.gz from IMAGE_FSTYPES
IMAGE_TYPES_MASKED = "tar.gz"

# Default serial console for QCOM devices
SERIAL_CONSOLES ??= "115200;ttyMSM0"

INITRAMFS_MAXSIZE = "393216"

# Boot image settings
QCOM_BOOTIMG_KERNEL_BASE ?= "0x80000000"
QCOM_BOOTIMG_PAGE_SIZE ?= "4096"
QCOM_BOOTIMG_ROOTFS ?= "/dev/disk/by-partlabel/system"

#
# Below are variables are backport from meta/conf/image-uefi.conf master branch
#
EFI_ARCH = "aa64"

# Location of UKI inside EFI System Partition
EFI_UKI_DIR ?= "/EFI/Linux"
EFI_UKI_PATH = "${EFI_PREFIX}${EFI_UKI_DIR}"

# Use systemd-boot as the EFI bootloader
EFI_PROVIDER = "systemd-boot"

# Install packages at root of ESP
EFI_PREFIX = ""

# Location of dtb inside ESP
EFI_DTB_DIR ?= "${EFI_PREFIX}dtb"

# Unified Kernel Image (UKI) name
EFI_LINUX_IMG ?= "linux-${MACHINE}.efi"

# Place dtb at EFIDTDIR to seamlessly package
KERNEL_DTBDEST = "${EFI_DTB_DIR}"

CORE_IMAGE_EXTRA_INSTALL:sota += "efimount"
CORE_IMAGE_EXTRA_INSTALL:sota += "varmount"
IMAGE_CLASSES += "image_types_ota_sdboot"
```

## meta-avocado-tpm/conf/layer.conf
```bitbake
# We have a conf and classes directory, add to BBPATH
BBPATH .= ":${LAYERDIR}"

# We have recipes-* directories, add to BBFILES
BBFILES += "${LAYERDIR}/recipes-*/*/*.bb \
            ${LAYERDIR}/recipes-*/*/*.bbappend"

BBFILE_COLLECTIONS += "meta-avocado-tpm"
BBFILE_PATTERN_meta-avocado-tpm = "^${LAYERDIR}/"
BBFILE_PRIORITY_meta-avocado-tpm = "8"

LAYERDEPENDS_meta-avocado-tpm = "core"
LAYERSERIES_COMPAT_meta-avocado-tpm = "scarthgap"
```

## meta-avocado/conf/machine/avocado-container-arm64.conf
```bitbake
#@TYPE: Machine
#@NAME: Container arm64 machine
#@DESCRIPTION: Machine configuration for running an arm64 container image

MACHINEOVERRIDES =. "qemuarm64:avocado-container-arm64:avocado-container"
KMACHINE = "qemuarm64"

require conf/machine/include/arm/armv8a/tune-cortexa57.inc
require conf/machine/include/qemu.inc

PREFERRED_PROVIDER_virtual/kernel = "linux-dummy"
```

## meta-avocado/conf/machine/avocado-container-x86_64.conf
```bitbake
#@TYPE: Machine
#@NAME: Containerx86_64 machine
#@DESCRIPTION: Machine configuration for running an x86-64 container image

MACHINEOVERRIDES =. "qemux86-64:avocado-container-x86_64:avocado-container"
KMACHINE = "qemux86-64"

require conf/machine/include/qemu.inc
DEFAULTTUNE ?= "core2-64"
require conf/machine/include/x86/tune-x86-64-v3.inc
require conf/machine/include/x86/qemuboot-x86.inc

MACHINE_FEATURES += "x86 pci"

PREFERRED_PROVIDER_virtual/kernel = "linux-dummy"
```
