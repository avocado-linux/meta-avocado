## meta-avocado/conf/distro/avocado-container.conf
```bitbake
# Disable runtime components not needed for SDK container builds
VIRTUAL-RUNTIME_dev_manager = ""
VIRTUAL-RUNTIME_init_manager = ""
VIRTUAL-RUNTIME_login_manager = ""
VIRTUAL-RUNTIME_initscripts = ""
VIRTUAL-RUNTIME_keymaps = ""
VIRTUAL-RUNTIME_hwclock = ""
VIRTUAL-RUNTIME_mount_manager = ""
VIRTUAL-RUNTIME_network_init = ""
VIRTUAL-RUNTIME_syslog = ""
VIRTUAL-RUNTIME_udev = ""

PREFERRED_PROVIDER_virtual/base-utils = "packagegroup-core-base-utils"
VIRTUAL-RUNTIME_base-utils = "packagegroup-core-base-utils"
VIRTUAL-RUNTIME_base-utils-hwclock = "util-linux-hwclock"
VIRTUAL-RUNTIME_base-utils-syslog = "sysklogd"

DISTRO_FEATURES:remove = "systemd"
DISTRO_FEATURES_EXTRA ?= ""
DISTRO_FEATURES:append = " usrmerge ${DISTRO_FEATURES_EXTRA}"
INIT_MANAGER = "none"

require conf/distro/avocado.inc
```
