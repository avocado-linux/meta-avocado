## meta-avocado-rubikpi/conf/machine/include/qcom-qcs6490.inc
```bitbake
DEFAULTTUNE = "armv8-2a-crypto"
require conf/machine/include/arm/arch-armv8-2a.inc

SOC_FAMILY = "qcm6490"
require conf/machine/include/qcom-base.inc

# Additional Kernel cmdline parameters for debug builds
DBG_CMDLINE = "${@oe.utils.conditional('DEBUG_BUILD','1','earlycon page_owner=on qcom_scm.download_mode=1 slub_debug=FZP,zs_handle,zspage;FZPU','',d)}"

KERNEL_CMDLINE_EXTRA ?= "pcie_pme=nomsi rcupdate.rcu_expedited=1 rcu_nocbs=0-7 kpti=off kasan=off kasan.stacktrace=off no-steal-acc ${DBG_CMDLINE} swiotlb=128 mitigations=auto net.ifnames=0"

MACHINE_ESSENTIAL_EXTRA_RRECOMMENDS += "kernel-modules \
    kernel-module-qca6490"

MACHINE_EXTRA_RDEPENDS += "packagegroup-firmware-qcm6490"
```

## meta-avocado-solidrun/conf/machine/avocado-rzv2n-sr-som.conf
```bitbake
#@TYPE: Machine
#@NAME: SolidRun RZ/V2N System on Module
#@DESCRIPTION: Machine configuration for SolidRun RZ/V2N SoM on HummingBoard IIOT

require conf/machine/include/avocado.inc

require conf/machine/include/rzv2n-family.inc
require conf/machine/include/arm/armv8-2a/tune-cortexa55.inc

MACHINEOVERRIDES:prepend = "rzv2n-sr-som:"

SERIAL_CONSOLES ?= "115200;ttySC0"
PREFERRED_VERSION_trusted-firmware-a ?= "2.10%"
TFA_PLATFORM ?= "v2n"
TFA_BOARD ?= "evk_1"
TFA_UBOOT ?= "1"
TFA_BUILD_TARGET ?= "bl2 fip"
BL2_BOOT_TARGET ?= "spi mmc esd"
EXTRA_IMAGEDEPENDS += " firmware-pack"

BL2_BASE_ADDR ?= "0x08103000"
BL2_ADJUST_VMA ?= "0x08101E00"
FIP_ADJUST_VMA ?= "0x0"

# U-Boot Configuration
PREFERRED_VERSION_u-boot ?= "2024.07%"
UBOOT_CONFIG ??= "rzv2n-solidrun"
UBOOT_CONFIG[rzv2n-solidrun] = "rzv2n-solidrun_defconfig"

# flash writer
EXTRA_IMAGEDEPENDS += " flash-writer"

KERNEL_DEVICETREE = " \
		renesas/r9a09g056n48-hummingboard-iiot.dtb \
		renesas/rzv2n-hummingboard-iiot-panel-dsi-WJ70N3TYJHMNG0.dtbo \
		renesas/rzv2n-hummingboard-iiot-csi-camera-imx678.dtbo \
		renesas/r9a09g056n48-solidsense-aiot.dtb \
		renesas/r9a09g056n48-rzv2n-evk.dtb \
"

IMAGE_BOOT_FILES = " \
	bl2_bp_spi-${MACHINE}.bin \
	bl2_bp_spi-${MACHINE}.srec \
	bl2_bp_mmc-${MACHINE}.bin \
	bl2_bp_mmc-${MACHINE}.srec \
	fip-${MACHINE}.bin \
	fip-${MACHINE}.srec \
	Flash_Writer_SCIF_RZV2N_SR_SOM_8GB_LPDDR4X.mot \
"

# Machine configuration
MACHINE_FEATURES = "opengles opencl mali-g31 bluetooth rtc serial usbgadget usbhost wifi"

# Linux kernel configuration
KERNEL_IMAGETYPE = "Image.gz"

# install kernel as "Image" — U-Boot decompresses Image.gz fine regardless
IMAGE_BOOT_FILES:append = " ${KERNEL_IMAGETYPE};Image "

# install DTBs under renesas/ for U-Boot distro boot
# U-Boot fdtfile env includes the renesas/ prefix
IMAGE_BOOT_FILES:prepend = "r9a09g056n48-hummingboard-iiot.dtb;sentinel.dtb "
IMAGE_BOOT_FILES:append = " \
	r9a09g056n48-hummingboard-iiot.dtb;renesas/r9a09g056n48-hummingboard-iiot.dtb \
	rzv2n-hummingboard-iiot-panel-dsi-WJ70N3TYJHMNG0.dtbo;renesas/rzv2n-hummingboard-iiot-panel-dsi-WJ70N3TYJHMNG0.dtbo \
	rzv2n-hummingboard-iiot-csi-camera-imx678.dtbo;renesas/rzv2n-hummingboard-iiot-csi-camera-imx678.dtbo \
	r9a09g056n48-solidsense-aiot.dtb;renesas/r9a09g056n48-solidsense-aiot.dtb \
	r9a09g056n48-rzv2n-evk.dtb;renesas/r9a09g056n48-rzv2n-evk.dtb \
"

# include drivers & support packages
# RZ/G2LC System on Module
MACHINE_ESSENTIAL_EXTRA_RDEPENDS:append = " \
	kernel-module-brcmfmac \
	kernel-module-brcmutil \
	kernel-module-btbcm \
	kernel-module-cfg80211 \
	kernel-module-hci-uart \
"
# Murata out-of-tree driver
# MACHINE_ESSENTIAL_EXTRA_RDEPENDS:append = " kernel-module-murata-cyw-fmac "
# HummingBoard
MACHINE_ESSENTIAL_EXTRA_RDEPENDS:append = " \
	kernel-module-userspace-consumer \
"
# include drivers & support packages
MACHINE_ESSENTIAL_EXTRA_RDEPENDS:append = " \
	linux-firmware-sr-rz-cyw43455 \
"

# RZ/V2N default packages for system utilities and debugging
MACHINE_EXTRA_RRECOMMENDS:append = " \
	kernel-modules \
	ethtool \
	memtester \
	stress-ng \
	iperf3 \
	libgpiod \
	libgpiod-tools \
	pciutils \
	pciutils-ids \
	iw \
	wpa-supplicant \
	wireless-regdb \
	bluez5 \
	bluez5-obex \
	usbutils \
"

AVOCADO_VAR_PART_DEV = "/dev/mmcblk1p3"
```

## meta-avocado-synaptics/conf/machine/avocado-grinn-astra-1680-sbc.conf
```bitbake
#@TYPE: Machine
#@NAME: Grinn Astra 1680 SBC
#@DESCRIPTION: Grinn SBC based on the Synaptics Astra SL1680 SoC

STONE_PROVISIONING ?= "img sd"
GRINN_MACHINE = "${MACHINE_SHORT_NAME}"
MACHINEOVERRIDES =. "${GRINN_MACHINE}:"

require conf/machine/include/avocado.inc
require conf/machine/include/avocado-synaptics.inc

require conf/machine/grinn-astra-1680-sbc.conf

ENABLE_RESCUE_MODE = "0"

SYNA_KERNEL_DTS_FILE:${GRINN_MACHINE} = "synaptics/grinn-astra-1680-sbc.dtb"
SYNA_U_BOOT_DTS_FILE:${GRINN_MACHINE} = "grinn-astra-1680-sbc.dtb"
SYNA_SDK_CONFIG_NAME = "sl1680_poky_aarch64_rdk"

PREFERRED_VERSION_meson = "1.7.0"
PREFERRED_VERSION_meson-native = "1.7.0"

IMAGE_MACHINE_SUFFIX = "-${MACHINE_SHORT_NAME}"

INITRAMFS_IMAGE_BUNDLE = "1"
INITRAMFS_IMAGE = "core-image-initramfs-boot"
ROOT_FSTYPES = "erofs-lz4 synaimg"

MACHINE_EXTRA_RRECOMMENDS += "kernel-modules"

AVOCADO_VAR_PART_DEV = "/dev/disk/by-partlabel/var"
```
