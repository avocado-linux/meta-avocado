## meta-avocado-qemu/wic/avocado-qemuarm64.wks
```
bootloader --ptable gpt --configfile="qemuarm64.cfg"

part /boot --ondisk=vda --align 64 --size=100M --active --source bootimg-partition --fstype=ext4     --label boot --sourceparams="loader=u-boot"
part /     --ondisk=vda                                 --source rootfs            --fstype=squashfs      --align 1024 --part-type b921b045-1df0-41c3-af44-4c6f280d3fae
part /var --source rawcopy --sourceparams="file=${DEPLOY_DIR_IMAGE}/avocado-image-var-${MACHINE}.var.img" --fstype=btrfs --align 1024 --uuid 4d21b016-b534-45c2-a9fb-5c16e091fd2d
```

## meta-avocado-raspberrypi/conf/machine/avocado-fr202.conf
```bitbake
BOOTVARS = "ubootenv"
STONE_PROVISIONING ?= "img sd usb-emmc usb-sata"
MACHINEOVERRIDES =. "bootvars-${BOOTVARS}:fr202:fr200:onlogic:"

require conf/machine/avocado-raspberrypi4.conf

RPI_KERNEL_DEVICETREE_OVERLAYS:append = " \
  overlays/vc4-kms-v3d-pi4.dtbo \
"
PACKAGECONFIG:append:pn-qtbase = " eglfs "
KERNEL_MODULE_AUTOLOAD:rpi += "i2c-dev"
```

## meta-avocado-raspberrypi/conf/machine/avocado-raspberrypi.inc
```bitbake
UBOOT_ENV_SIZE = "0x20000"

IMAGE_BOOT_FILES:append = " avocado-image-initramfs-${MACHINE}.cpio.zst;avocado-initramfs.cpio.zst"

RPI_USE_U_BOOT = "1"

CMDLINE_ROOT_PARTITION = "/dev/mmcblk0p2"
CMDLINE_ROOT_FSTYPE = "rootfstype=squashfs"

AVOCADO_VAR_PART_DEV = "/dev/mmcblk0p3"

DEPENDS:append:pn-mesa = " libxshmfence"
```

## meta-avocado-raspberrypi/conf/machine/avocado-reterminal-dm.conf
```bitbake
BOOTVARS = "ubootenv"
STONE_PROVISIONING ?= "img usb usb-emmc usb-nvme"
MACHINEOVERRIDES =. "bootvars-${BOOTVARS}:seeed-reterminal-dm:reterminal-dm:seeed:cm4:"

VC4DTBO ?= "vc4-kms-v3d-pi4"

PREFERRED_VERSION_linux-raspberrypi ?= "6.12%"

require conf/machine/avocado-raspberrypi4.conf

IMAGE_BOOT_FILES:append = " devicetree/reTerminal-DM.dtbo;overlays/reTerminal-DM.dtbo"

RPI_KERNEL_DEVICETREE_OVERLAYS:append = " \
  overlays/i2c0.dtbo \
  overlays/i2c1.dtbo \
  overlays/i2c3.dtbo \
  overlays/i2c6.dtbo \
  overlays/vc4-kms-v3d-pi4.dtbo \
"

ENABLE_SPI = "1"
ENABLE_I2C = "1"
ENABLE_UART = "1"

CMDLINE:append = " vc4.force_hotplug=1 video=HDMI-A-1:d"

PACKAGECONFIG:append:pn-qtbase = " eglfs "
KERNEL_MODULE_AUTOLOAD:rpi += "i2c-dev spi-dev"
```

## meta-avocado-raspberrypi/conf/machine/avocado-reterminal.conf
```bitbake
BOOTVARS = "ubootenv"
STONE_PROVISIONING ?= "img usb"
MACHINEOVERRIDES =. "bootvars-${BOOTVARS}:seeed-reterminal:reterminal:seeed:"

require conf/machine/avocado-raspberrypi4.conf

IMAGE_BOOT_FILES:append = " devicetree/reTerminal.dtbo;overlays/reTerminal.dtbo"

RPI_KERNEL_DEVICETREE_OVERLAYS:append = " \
  overlays/i2c3.dtbo \
  overlays/vc4-kms-v3d-pi4.dtbo \
"
PACKAGECONFIG:append:pn-qtbase = " eglfs "
KERNEL_MODULE_AUTOLOAD:rpi += "i2c-dev"
```
