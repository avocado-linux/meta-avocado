## meta-avocado-nvidia/conf/machine/avocado-jetson-agx-orin-devkit.conf
```bitbake
#@TYPE: Machine
#@NAME: Nvidia Jetson AGX Orin dev kit
#@DESCRIPTION: Nvidia Jetson AGX Orin dev kit (P3701-0000 module in P3737-0000 carrier)

require conf/machine/include/avocado-jetson.inc
require conf/machine/include/avocado.inc

TEGRA_BUPGEN_SPECS ?= "fab=300;boardsku=0000;boardrev=;chipsku=00:00:00:D0;bup_type=bl \
                       fab=300;boardsku=0000;boardrev=;bup_type=kernel"
KERNEL_DEVICETREE ?= "tegra234-p3737-0000+p3701-0000-nv.dtb"

MACHINEOVERRIDES =. "jetson-agx-orin-devkit:"
AVOCADO_VAR_PART_DEV = "/dev/nvme0n1p16"

TNSPEC_BOOTDEV ?= "nvme0n1p1"
TEGRA_BOARDSKU ?= "0005"

PARTITION_LAYOUT_TEMPLATE_DEFAULT_SUPPORTS_REDUNDANT ?= "1"
PARTITION_LAYOUT_EXTERNAL_DEFAULT ?= "flash_l4t_t234_nvme.xml"

require conf/machine/include/agx-orin.inc
require conf/machine/include/devkit-wifi.inc

KERNEL_ARGS:append = " audit=0 nvme_core.default_ps_max_latency_us=0 pcie_aspm=off"
KERNEL_MODULE_AUTOLOAD:append = " nvme"
```

## meta-avocado-nvidia/conf/machine/avocado-jetson-agx-thor-devkit.conf
```bitbake
#@TYPE: Machine
#@NAME: Nvidia Jetson AGX Thor devkit
#@DESCRIPTION: Nvidia Jetson AGX Thor devkit (P3834-0008 module in P4071-0000 carrier with NVMe)

require conf/machine/include/avocado-jetson.inc
require conf/machine/include/avocado.inc

MACHINEOVERRIDES =. "jetson-agx-thor-devkit:"

TNSPEC_BOOTDEV ?= "nvme0n1p1"
PARTITION_LAYOUT_TEMPLATE_DEFAULT ?= "flash_l4t_t264_qspi.xml"
PARTITION_LAYOUT_TEMPLATE_DEFAULT_SUPPORTS_REDUNDANT ?= "1"
PARTITION_LAYOUT_EXTERNAL_DEFAULT ?= "flash_l4t_t264_nvme.xml"

require conf/machine/include/tegra264.inc
require conf/machine/include/devkit-wifi.inc

TEGRA_BUPGEN_SPECS ?= " \
    fab=000;boardsku=0008;boardrev=;chiprev=;chipsku=00:00:00:A0;bup_type=bl \
    fab=401;boardsku=0008;boardrev=;chiprev=;chipsku=00:00:00:A0;bup_type=bl \
"

TEGRA_BOARDID ?= "3834"
TEGRA_FAB ?= "400"
TEGRA_BOARDSKU ?= "0008"
TEGRA_BOARDREV ?= "G.5"
TEGRA_CHIPREV ?= "1"

KERNEL_DEVICETREE ?= "tegra264-p4071-0000+p3834-0008-nv.dtb"
ROOTFSPART_SIZE_DEFAULT ?= "53687091200"
TEGRA_FLASHVAR_ODMDATA ?= ""
EMC_BCT ?= "tegra264-p3834-0008-sdram-bct-l4t.dts"
TEGRA_AUDIO_DEVICE ?= "tegra-hda-p3767-p3509"

TEGRA_PLUGIN_MANAGER_OVERLAYS ?= "tegra264-p4071-0000+p3834-xxxx-dynamic.dtbo"
TEGRA_FLASHVAR_BPFDTB_FILE ?= "tegra264-bpmp-3834-0008-4071-xxxx.dtb"
TEGRA_FLASHVAR_BPF_FILE ?= "bpmp_t264-TA1090SA-A1_prod.bin"
TEGRA_FLASHVAR_CHIP_SKU ?= "00:00:00:A0"
TEGRA_FLASHVAR_DEVICEPROD_CONFIG ?= "tegra264-mb1-bct-cprod-p3834-xxxx-p4071-0000.dts"
TEGRA_FLASHVAR_DEVICE_CONFIG ?= "tegra264-mb1-bct-device-p3834-xxxx.dts"
TEGRA_FLASHVAR_DEV_PARAMS ?= "tegra264-br-bct-common-l4t.dts"
TEGRA_FLASHVAR_DEV_PARAMS_B ?= ""
TEGRA_FLASHVAR_EMC_FUSE_DEV_PARAMS ?= "tegra264-br-bct-diag-boot.dts"
TEGRA_FLASHVAR_GPIOINT_CONFIG ?= "tegra264-mb1-bct-gpioint-p3834-xxxx-p4071-0000.dts"
TEGRA_FLASHVAR_MB2BCT_CFG ?= "tegra264-mb2-bct-misc-p3834-xxxx-p4071-0000.dts"
TEGRA_FLASHVAR_MINRATCHET_CONFIG ?= "--minratchet_config tegra264-mb1-bct-ratchet-p3834-xxxx-p4071-0000.dts"
TEGRA_FLASHVAR_MISC_CONFIG ?= "tegra264-mb1-bct-misc-p3834-0008-p4071-0000.dts"
TEGRA_FLASHVAR_PINMUX_CONFIG ?= "tegra264-mb1-bct-pinmux-p3834-xxxx-p4071-0000.dts"
TEGRA_FLASHVAR_PMC_CONFIG ?= "tegra264-mb1-bct-padvoltage-p3834-xxxx-p4071-0000.dts"
TEGRA_FLASHVAR_PMIC_CONFIG ?= "tegra264-mb1-bct-pmic-p3834-0008-p4071-0000.dts"
TEGRA_FLASHVAR_PROD_CONFIG ?= "tegra264-mb1-bct-prod-p3834-xxxx-p4071-0000.dts"
TEGRA_FLASHVAR_RAMCODE ?= "12"
TEGRA_FLASHVAR_SCR_CONFIG ?= "tegra264-mb2-bct-firewall-p3834-xxxx-p4071-0000.dts"
TEGRA_FLASHVAR_UPHY_CONFIG ?= "tegra264-mb1-bct-uphy-lanes-p4071-0000.dts"
TEGRA_FLASHVAR_WB0SDRAM_BCT ?= "tegra264-p3834-0008-sdram-bct-warmboot-l4t.dts"
TEGRA_FLASHVAR_BPMP_MEM_CONFIG ?= "tegra264-p3834-0008-sdram-dfs.dts"

KERNEL_ARGS:append = " audit=0 nvme_core.default_ps_max_latency_us=0 pcie_aspm=off"
KERNEL_MODULE_AUTOLOAD:append = " nvme"
```

## meta-avocado-nvidia/conf/machine/avocado-jetson-orin-nano-devkit.conf
```bitbake
#@TYPE: Machine
#@NAME: Nvidia Jetson Orin Nano devkit
#@DESCRIPTION: Nvidia Jetson Orin Nano devkit using NVMe drive for rootfs

require conf/machine/include/avocado-jetson.inc
require conf/machine/include/avocado.inc

MACHINEOVERRIDES =. "jetson-orin-nano-devkit:"

TNSPEC_BOOTDEV ?= "nvme0n1p1"
PARTITION_LAYOUT_TEMPLATE_DEFAULT ?= "flash_t234_qspi.xml"
PARTITION_LAYOUT_TEMPLATE_DEFAULT_SUPPORTS_REDUNDANT ?= "1"
PARTITION_LAYOUT_EXTERNAL_DEFAULT ?= "flash_l4t_t234_nvme.xml"

require conf/machine/include/orin-nano.inc
require conf/machine/include/devkit-wifi.inc

KERNEL_ARGS:append = " audit=0 nvme_core.default_ps_max_latency_us=0 pcie_aspm=off"
KERNEL_MODULE_AUTOLOAD:append = " nvme"
```

## meta-avocado-nvidia/conf/machine/avocado-recomputer-j301x.conf
```bitbake
#@TYPE: Machine
#@NAME: Seeed Studio Recomputer J301x
#@DESCRIPTION: Seeed Studio Recomputer J301x

require conf/machine/include/avocado-jetson.inc
require conf/machine/include/avocado.inc

MACHINEOVERRIDES =. "recomputer-j301x:jetson-orin-nano-devkit:"
AVOCADO_VAR_PART_DEV = "/dev/nvme0n1p16"

TNSPEC_BOOTDEV ?= "nvme0n1p1"
PARTITION_LAYOUT_TEMPLATE_DEFAULT ?= "flash_t234_qspi.xml"
PARTITION_LAYOUT_TEMPLATE_DEFAULT_SUPPORTS_REDUNDANT ?= "1"
PARTITION_LAYOUT_EXTERNAL_DEFAULT ?= "flash_l4t_t234_nvme.xml"

require conf/machine/include/orin-nano.inc
require conf/machine/include/devkit-wifi.inc
```

## meta-avocado-nvidia/conf/machine/avocado-recomputer-j401x.conf
```bitbake
#@TYPE: Machine
#@NAME: Seeed Studio Recomputer J401x
#@DESCRIPTION: Seeed Studio Recomputer J401x

require conf/machine/include/avocado-jetson.inc
require conf/machine/include/avocado.inc

MACHINEOVERRIDES =. "recomputer-j401x:"

TNSPEC_BOOTDEV ?= "nvme0n1p1"
PARTITION_LAYOUT_TEMPLATE_DEFAULT ?= "flash_t234_qspi.xml"
PARTITION_LAYOUT_TEMPLATE_DEFAULT_SUPPORTS_REDUNDANT ?= "1"
PARTITION_LAYOUT_EXTERNAL_DEFAULT ?= "flash_l4t_t234_nvme.xml"

require conf/machine/include/orin-nx.inc
require conf/machine/include/devkit-wifi.inc
```
